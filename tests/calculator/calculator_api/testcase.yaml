## tests/drivers/gpio/gpio_api/gpio/zephyr/Kconfig
```kconfig
#Copyright 2022 Freedom Veículos Elétricos LTDA.
#SPDX - License - Identifier : Apache - 2.0

config ZPP bool "Support for ZPP out of tree driver"
```

## tests/drivers/gpio/gpio_basic_api/testcase.yaml
```yaml
common:
    tags: drivers gpio
    depends_on: gpio
    harness: ztest
    #harness_config:
    #  fixture: gpio_loopback

tests:
  drivers.gpio.2pin:
    min_flash: 34
    filter: dt_compat_enabled("test-gpio-basic-api")
    platform_allow: native_posix_64
```

## west.yml
```yaml
# Copyright 2022 Freedom Veículos Elétricos LTDA.
# SPDX-License-Identifier: Apache-2.0

manifest:
  remotes:
    - name: zephyrproject-rtos
      url-base: https://github.com/zephyrproject-rtos
    - name: freedom
      url-base: https://github.com/FreedomVeiculosEletricos
  projects:
    - name: zephyr
      remote: freedom
      revision: e89c174ca984805b2c60bd6484c696e98453b718 # 2022-12-30
  self:
    import:
```
