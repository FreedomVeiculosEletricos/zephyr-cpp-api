## CMakeLists.txt
```
#Copyright 2022 Freedom Veículos Elétricos LTDA.
#SPDX - License - Identifier : Apache - 2.0

list(APPEND ZEPHYR_EXTRA_MODULES ${CMAKE_CURRENT_SOURCE_DIR} / gpio)

    cmake_minimum_required(VERSION 3.20.0)

        find_package(Zephyr REQUIRED HINTS $ENV{ZEPHYR_BASE}) project(gpio_api)

            target_sources(app PRIVATE src / main.cpp)
```

## prj.conf
```kconfig
# Copyright 2022 Freedom Veículos Elétricos LTDA.
# SPDX-License-Identifier: Apache-2.0

CONFIG_GPIO=y
CONFIG_GPIO_GET_CONFIG=y
CONFIG_ZTEST=y
CONFIG_ZTEST_NEW_API=y
CONFIG_ENTROPY_GENERATOR=y
CONFIG_TEST_RANDOM_GENERATOR=y
CONFIG_CPLUSPLUS=y
CONFIG_STD_CPP20=y
CONFIG_LIB_CPLUSPLUS=y
CONFIG_NEWLIB_LIBC=y
CONFIG_APPLICATION_DEFINED_SYSCALL=y
CONFIG_ZPP=y
#CONFIG_TEST_USERSPACE=y
```

## src/main.cpp
```c
/*
 *Copyright 2022 Freedom Veículos Elétricos LTDA.
 * SPDX-License-Identifier: Apache-2.0
 */

#include "gpi.hpp"
#include "gpo.hpp"
#include <zephyr/drivers/gpio.h>
#include <zephyr/kernel.h>
#include <zephyr/sys/util.h>
#include <zephyr/ztest.h>

struct gpio_dt_spec io = GPIO_DT_SPEC_GET(DT_ALIAS(led0), gpios);

ZTEST_F(gpio_basic_api, test_set) {
  zephyrcppapi::Gpo output{io};
  int rv = output.set();
  zassert_equal(true, rv, "gpio_pin_is_output() failed: %d", rv);
}

ZTEST_F(gpio_basic_api, test_reset) {
  zephyrcppapi::Gpo output{io};
  int rv = output.reset();
  zassert_equal(true, rv, "gpio reset failed: %d", rv);
}

ZTEST_F(gpio_basic_api, test_get) {
  zephyrcppapi::Gpi input{io};
  int rv = input.get();
  zassert_equal(true, rv, "gpio reset failed: %d", rv);
}

ZTEST_SUITE(gpio_basic_api, NULL, NULL, NULL, NULL, NULL);
```
